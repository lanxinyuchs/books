## Kconfig
```kconfig
#
# RBS core configuration
#
menuconfig RBS_CORE
       bool "RBS core support"
       default n
       ---help---
         Say Y here if you want driver support for the RBS
	 platform drivers.

if RBS_CORE

config RBS_RWSEM_STAT
       bool "RBS lightweight read-write semaphore statistics"
       default n
       --- help ---
          Say Y here if you want to keep track of rbs rwsem lock
          usage and contention. Will add a few ns of OH in time each
          time a lock is taken/released.
          To check statistics you will have to call a buil-in function
          that dumps info to the klog.

config RBS_RWSEM_PARANOID
       bool "RBS lightweight read-write semaphore sanity checks"
       default n
       --- help ---
          Say Y here if you are debugging and want to make sure
          that you are not using un-initialized lock variables or
          attempting to use rbs rwsems from inside interrupt ctx.
          Will add a few ns of OH in time each time a lock is taken.

config RBS_DEBUG
	bool "RBS core debug messages"
	---help---
	  Say Y here if you want RBS core to produce a bunch of
	  debug messages to the system log. Select this if you are having a
	  problem with the RBS platform and want to see more of what is
	  going on.

	  If you are unsure about this, say N here.

menu "RBS builtin board type support"

source "drivers/rbs/sys/Kconfig"

endmenu #

menu "RBS error buffer options"

config RBSERR_ENTRY_SIZE
	int "Error entry size"
	default "256"

config RBSERR_BUFFER_SIZE
	int "Error buffer size"
	default "65536"

endmenu # error options

menu "RBS SMEM options"

config RBSSMEM_HAS_PERSISTENT
	bool "SMEM has persistent region"
	default y if ACP
	default n

config RBSSMEM_PERSIST_ADDR
	hex "Persistent region base address"
	default "0x00100000"

config RBSSMEM_PERSIST_SIZE
	hex "Persisten region size"
	default "0xef000"

endmenu # SMEM options

menu "RBS platform drivers"

source "drivers/rbs/gpio/Kconfig"
source "drivers/rbs/misc/Kconfig"
source "drivers/rbs/time/Kconfig"
source "drivers/rbs/fpga/Kconfig"
source "drivers/rbs/sec/Kconfig"
source "drivers/rbs/hwl/Kconfig"
source "drivers/rbs/mtdpart/Kconfig"

endmenu

endif   # if RBS_CORE

#endmenu
```

## fpga/Kconfig
```kconfig
# Ericsson FPGA driver configuration
#
menuconfig RBS_FPGA
       bool "RBS FPGA driver support"
       default y
       ---help---
         Say Y here if you want FPGA driver support for the RBS
	 platform.

if RBS_FPGA

source "drivers/rbs/fpga/icm1/Kconfig"

endif   # if RBS_FPGA
```

## fpga/icm1/Kconfig
```kconfig
# Ericsson ICM1 driver configuration
#
config ICM1
	tristate "ICM1 support"
	default n
	select FW_LOADER
	depends on ARCH_CPM2 || ARCH_CPM1
	---help---
	ICM1 driver
```

## gpio/Kconfig
```kconfig
# Ericsson gpio configuration
#

config RBS_GPIO
	tristate "RBS GPIO driver"
	default n
	---help---
	RBS GPIO driver provides access to GPIO pins from userspace
	(including interrupts)

config RBS_GPIO_MAXPINS
	depends on RBS_GPIO
	int "RBS GPIO maximum number of pins"
	default "32"
```

## hwl/Kconfig
```kconfig
# Ericsson hwl configuration
#

config RBS_HWL
	tristate "RBS HWL driver"
	default y
	---help---
	RBS HWL driver provides access to HW Log from userspace

config RBS_HWL_DEVNAME
	depends on RBS_HWL
	string "RBS HWL flush partition name"
	default "hw_log"
```

## misc/Kconfig
```kconfig
# Ericsson misc configuration
#

config CPM_MISC_GTACC
	tristate "CPM1/CPM2 MISC generic timer user-space access"
	depends on (ARCH_CPM1 || ARCH_CPM2) && !ARM_ARCH_CNTPCT_FROM_USER
	default m
	---help---
	Enables user-space access to CNTPCT and CNTFRQ register

config CPM1_MISC_PHACC
	tristate "CPM1 MISC user-space access to Axxia peripherals"
	depends on ARCH_CPM1
	default m
	---help---
	Enables user-space access to Axxia peripherals

config CPM2_MISC_PHACC
	tristate "CPM2 MISC user-space access to Axxia peripherals"
	depends on ARCH_CPM2
	default m

config CPM1_MISC_SYSTEM_WATCHDOG
       bool "CPM1 System Watchdog"
       depends on ARCH_CPM1
       default y
       help
          CPM1 System watchdog kicker

config CPM1_KERNEL_SYSWD_SETUP
       bool "Enable CPM1 System Watchdog in early boot"
       depends on CPM1_MISC_SYSTEM_WATCHDOG
       default n

config CPM_MISC_SYSTEM_WATCHDOG
       bool "CPM2 System Watchdog"
       depends on ARCH_CPM2
       default y
       help
          CPM2 System watchdog kicker

config CPM_KERNEL_SYSWD_SETUP
       bool "Enable CPM2 System Watchdog in early boot"
       depends on CPM2_MISC_SYSTEM_WATCHDOG
       default n
```

## mtdpart/Kconfig
```kconfig
# Ericsson MTDPART configuration
#

config RBS_MTDPART
	tristate "RBS MTDPART handler"
	default y
	---help---
	RBS MTDPART handler provides interface to change MTD partition permissions from userspace
```

## sec/Kconfig
```kconfig
# Ericsson SEC driver configuration
#
config RBS_SBB_CPM1
	tristate "RBS Security subsystem SBB driver"
	depends on RBS_SYS_CPM1
	default y
	---help---
	Axxia 55 SBB driver.
	Provides access to the Secure Data Storage (SDO) function of the SBB.

config RBS_SBB_CPM2
	tristate "RBS Security subsystem SBB driver"
	depends on RBS_SYS_CPM2
	default y
	---help---
	Axxia 56 SBB driver.
	Provides access to the Secure Data Storage (SDO) function of the SBB.

config RBS_FOOTPRINTS_19936
	bool "Apply w/a for SBB lock failure, reported with Footprints 19936"
	depends on RBS_SBB_CPM2
	default n
	---help---
	The Axxia 55 version of the SBB had a bug in this area, a command would
	fail because the SBB lock had been lost due to some dark magic and the
	only solution was to start over from the top and aquire the lock again.
	This bug is reported as fixed in Axxia 56.
	Say yes here if SBB commands fail, seemingly inexplicably, and you want
	to try out the Axxia 55 SW w/a.
	 

config RBS_SIM_ECM_READ_DONE_BUG
	bool "Apply simulator specific w/a for ECM read done"
	depends on RBS_SBB_CPM2
	default y
	---help---
	The SBB (Secure Boot Block) register map is present in acpsim, it can be
	read and written, but the registers are not [yet] backed by a functional
	simulation.
	Say yes here if you're building a simulator kernel and are unsure of the
	bug fix status of the target simulator.
```

## sys/Kconfig
```kconfig
if ARM

config RBS_SYS_CPM1
	bool "CPM1 based boards"
	select ARM_ARCH_TIMER
	default y

config RBS_SYS_TCU03
	bool "TCU board type support"
	depends on RBS_SYS_CPM1
	default y

config RBS_SYS_TCU04
	bool "TCU04 board type support"
	depends on RBS_SYS_CPM1
	default y

config RBS_SYS_C608
	bool "C608 board type support"
	depends on RBS_SYS_CPM1
	default y

config RBS_SYS_DUS32
	bool "DUS32 board type support"
	depends on RBS_SYS_CPM1
	default y

config RBS_SYS_DUS52
	bool "DUS52 board type support"
	depends on RBS_SYS_CPM1
	default y

config RBS_SYS_LOCKUP_DETECTOR
       bool "RBS Soft lockup detector"
       depends on RBS_CORE && !LOCKUP_DETECTOR
       default y

config RBS_SYS_WATCHDOG_THRESHOLD
       int "System watchdog expire time seconds"
       depends on RBS_SYS_LOCKUP_DETECTOR
       default 10

config RBS_SYS_SOFTLOCKUP_THRESHOLD
       int "Soft lockup warning expire time seconds"
       depends on RBS_SYS_LOCKUP_DETECTOR
       default 20
endif

if ARM64

config RBS_SYS_CPM2
	bool "CPM2 based boards"
	default y

config ARCH_CPM2
	bool "CPM2 architecture"
	default y
	depends on RBS_SYS_CPM2

config RBS_SYS_DUS33
	bool "DUS33 board type support"
	depends on RBS_SYS_CPM2
	default y

config RBS_SYS_DUS32_TK
	bool "DUS32-TK board type support (DUS33-based board)"
	depends on RBS_SYS_CPM2
	default y
	help
	  TK version of DUS32 board. Reuses main components from DUS33 board.

config RBS_SYS_DUS53
	bool "DUS53 board type support"
	depends on RBS_SYS_CPM2
	default y

config RBS_SYS_DUS52_TK
	bool "DUS52-TK board type support (DUS53-based board)"
	depends on RBS_SYS_CPM2
	default y
	help
	  TK version of DUS52 board. Reuses main components from DUS53 board.

config RBS_SYS_MDUSX3
	bool "mDUSx3 board type support"
	depends on RBS_SYS_CPM2
	default y

config RBS_SYS_LOCKUP_DETECTOR
       bool "RBS Soft lockup detector"
       depends on RBS_CORE && !LOCKUP_DETECTOR
       default y

config RBS_SYS_WATCHDOG_THRESHOLD
       int "System watchdog expire time seconds"
       depends on RBS_SYS_LOCKUP_DETECTOR
       default 10

config RBS_SYS_SOFTLOCKUP_THRESHOLD
       int "Soft lockup warning expire time seconds"
       depends on RBS_SYS_LOCKUP_DETECTOR
       default 20

config RBS_SYS_PLATFORM
       bool "RBS platform drivers"
       default y

endif
```

## time/Kconfig
```kconfig
# Ericsson time configuration
#

config CPM_TIME
	tristate "CPM time driver"
	default n
	depends on ARCH_CPM1 || ARCH_CPM2
	---help---
	CPM time driver: provides low overhead hr-timer service to rhai-time
```
